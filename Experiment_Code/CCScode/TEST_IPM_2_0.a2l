/******************************************************************************
* ASAP2 file: TEST_IPM_2_0.a2l
* Code generation for model "TEST_IPM_2_0".
* Model version : 1.179
* Simulink Coder version : 9.2 (R2019b) 18-Jul-2019
* C source code generated on : Thu Oct 31 09:33:51 2024
* Target selection: ert.tlc
* Embedded hardware selection: Texas Instruments->C2000
* Code generation objectives:
* 1. Execution efficiency
* 2. RAM efficiency
* 3. ROM efficiency
* Validation result: Not run
* (add additional file header information here)
******************************************************************************/ ASAP2_VERSION 1 31
/* Version 1.31 */
/begin PROJECT ProjectName "Project Comment Goes Here"
/begin HEADER "Header Comments go here" /end HEADER
/begin MODULE ModuleName "Module Comment Goes Here"
/begin MOD_PAR "MOD PAR Comment Goes Here" /end MOD_PAR
/begin MOD_COMMON "Mod Common Comment Here" BYTE_ORDER MSB_LAST /end MOD_COMMON
/begin RECORD_LAYOUT Scalar_BOOLEAN FNC_VALUES 1 UBYTE COLUMN_DIR DIRECT /end RECORD_LAYOUT
/begin RECORD_LAYOUT Scalar_UBYTE FNC_VALUES 1 UBYTE COLUMN_DIR DIRECT /end RECORD_LAYOUT
/begin RECORD_LAYOUT Scalar_BYTE FNC_VALUES 1 SBYTE COLUMN_DIR DIRECT /end RECORD_LAYOUT
/begin RECORD_LAYOUT Scalar_UWORD FNC_VALUES 1 UWORD COLUMN_DIR DIRECT /end RECORD_LAYOUT
/begin RECORD_LAYOUT Scalar_SWORD FNC_VALUES 1 SWORD COLUMN_DIR DIRECT /end RECORD_LAYOUT
/begin RECORD_LAYOUT Scalar_ULONG FNC_VALUES 1 ULONG COLUMN_DIR DIRECT /end RECORD_LAYOUT
/begin RECORD_LAYOUT Scalar_LONG FNC_VALUES 1 SLONG COLUMN_DIR DIRECT /end RECORD_LAYOUT
/begin RECORD_LAYOUT Scalar_FLOAT32_IEEE FNC_VALUES 1 FLOAT32_IEEE COLUMN_DIR DIRECT /end RECORD_LAYOUT
/begin RECORD_LAYOUT Scalar_FLOAT64_IEEE FNC_VALUES 1 FLOAT64_IEEE COLUMN_DIR DIRECT /end RECORD_LAYOUT
/begin RECORD_LAYOUT Lookup1D_BOOLEAN FNC_VALUES 1 UBYTE COLUMN_DIR DIRECT /end RECORD_LAYOUT
/begin RECORD_LAYOUT Lookup1D_X_BOOLEAN AXIS_PTS_X 1 UBYTE INDEX_INCR DIRECT /end RECORD_LAYOUT
/begin RECORD_LAYOUT Lookup1D_BYTE FNC_VALUES 1 SBYTE COLUMN_DIR DIRECT /end RECORD_LAYOUT
/begin RECORD_LAYOUT Lookup1D_X_BYTE AXIS_PTS_X 1 SBYTE INDEX_INCR DIRECT /end RECORD_LAYOUT
/begin RECORD_LAYOUT Lookup1D_UBYTE FNC_VALUES 1 UBYTE COLUMN_DIR DIRECT /end RECORD_LAYOUT
/begin RECORD_LAYOUT Lookup1D_X_UBYTE AXIS_PTS_X 1 UBYTE INDEX_INCR DIRECT /end RECORD_LAYOUT
/begin RECORD_LAYOUT Lookup1D_UWORD FNC_VALUES 1 UWORD COLUMN_DIR DIRECT /end RECORD_LAYOUT
/begin RECORD_LAYOUT Lookup1D_X_UWORD AXIS_PTS_X 1 UWORD INDEX_INCR DIRECT /end RECORD_LAYOUT
/begin RECORD_LAYOUT Lookup1D_WORD FNC_VALUES 1 SWORD COLUMN_DIR DIRECT /end RECORD_LAYOUT
/begin RECORD_LAYOUT Lookup1D_X_WORD AXIS_PTS_X 1 SWORD INDEX_INCR DIRECT /end RECORD_LAYOUT
/begin RECORD_LAYOUT Lookup1D_ULONG FNC_VALUES 1 ULONG COLUMN_DIR DIRECT /end RECORD_LAYOUT
/begin RECORD_LAYOUT Lookup1D_X_ULONG AXIS_PTS_X 1 ULONG INDEX_INCR DIRECT /end RECORD_LAYOUT
/begin RECORD_LAYOUT Lookup1D_SLONG FNC_VALUES 1 SLONG COLUMN_DIR DIRECT /end RECORD_LAYOUT
/begin RECORD_LAYOUT Lookup1D_X_LONG AXIS_PTS_X 1 SLONG INDEX_INCR DIRECT /end RECORD_LAYOUT
/begin RECORD_LAYOUT Lookup1D_FLOAT32_IEEE FNC_VALUES 1 FLOAT32_IEEE COLUMN_DIR DIRECT /end RECORD_LAYOUT
/begin RECORD_LAYOUT Lookup1D_X_FLOAT32_IEEE AXIS_PTS_X 1 FLOAT32_IEEE INDEX_INCR DIRECT /end RECORD_LAYOUT
/begin RECORD_LAYOUT Lookup1D_FLOAT64_IEEE FNC_VALUES 1 FLOAT64_IEEE COLUMN_DIR DIRECT /end RECORD_LAYOUT
/begin RECORD_LAYOUT Lookup1D_X_FLOAT64_IEEE AXIS_PTS_X 1 FLOAT64_IEEE INDEX_INCR DIRECT /end RECORD_LAYOUT
/begin RECORD_LAYOUT Lookup2D_BOOLEAN FNC_VALUES 1 UBYTE COLUMN_DIR DIRECT /end RECORD_LAYOUT
/begin RECORD_LAYOUT Lookup2D_X_BOOLEAN AXIS_PTS_X 1 UBYTE INDEX_INCR DIRECT /end RECORD_LAYOUT
/begin RECORD_LAYOUT Lookup2D_UBYTE FNC_VALUES 1 UBYTE COLUMN_DIR DIRECT /end RECORD_LAYOUT
/begin RECORD_LAYOUT Lookup2D_X_UBYTE AXIS_PTS_X 1 UBYTE INDEX_INCR DIRECT /end RECORD_LAYOUT
/begin RECORD_LAYOUT Lookup2D_BYTE FNC_VALUES 1 SBYTE COLUMN_DIR DIRECT /end RECORD_LAYOUT
/begin RECORD_LAYOUT Lookup2D_X_BYTE AXIS_PTS_X 1 SBYTE INDEX_INCR DIRECT /end RECORD_LAYOUT
/begin RECORD_LAYOUT Lookup2D_UWORD FNC_VALUES 1 UWORD COLUMN_DIR DIRECT /end RECORD_LAYOUT
/begin RECORD_LAYOUT Lookup2D_X_UWORD AXIS_PTS_X 1 UWORD INDEX_INCR DIRECT /end RECORD_LAYOUT
/begin RECORD_LAYOUT Lookup2D_WORD FNC_VALUES 1 SWORD COLUMN_DIR DIRECT /end RECORD_LAYOUT
/begin RECORD_LAYOUT Lookup2D_X_WORD AXIS_PTS_X 1 SWORD INDEX_INCR DIRECT /end RECORD_LAYOUT
/begin RECORD_LAYOUT Lookup2D_ULONG FNC_VALUES 1 ULONG COLUMN_DIR DIRECT /end RECORD_LAYOUT
/begin RECORD_LAYOUT Lookup2D_X_ULONG AXIS_PTS_X 1 ULONG INDEX_INCR DIRECT /end RECORD_LAYOUT
/begin RECORD_LAYOUT Lookup2D_LONG FNC_VALUES 1 SLONG COLUMN_DIR DIRECT /end RECORD_LAYOUT
/begin RECORD_LAYOUT Lookup2D_X_LONG AXIS_PTS_X 1 SLONG INDEX_INCR DIRECT /end RECORD_LAYOUT
/begin RECORD_LAYOUT Lookup2D_FLOAT32_IEEE FNC_VALUES 1 FLOAT32_IEEE COLUMN_DIR DIRECT /end RECORD_LAYOUT
/begin RECORD_LAYOUT Lookup2D_X_FLOAT32_IEEE AXIS_PTS_X 1 FLOAT32_IEEE INDEX_INCR DIRECT /end RECORD_LAYOUT
/begin RECORD_LAYOUT Lookup2D_FLOAT64_IEEE FNC_VALUES 1 FLOAT64_IEEE COLUMN_DIR DIRECT /end RECORD_LAYOUT
/begin RECORD_LAYOUT Lookup2D_X_FLOAT64_IEEE AXIS_PTS_X 1 FLOAT64_IEEE INDEX_INCR DIRECT /end RECORD_LAYOUT
/begin MEASUREMENT MRAS_Rs "" FLOAT32_IEEE TEST_IPM_2_0_CM_single 0 0 -3.4E+38 3.4E+38 ECU_ADDRESS 0x0000e020 /end MEASUREMENT
/begin MEASUREMENT Tem_Dem "" FLOAT32_IEEE TEST_IPM_2_0_CM_single 0 0 -3.4E+38 3.4E+38 ECU_ADDRESS 0x0000e022 /end MEASUREMENT
/begin MEASUREMENT Tem_Step "" FLOAT32_IEEE TEST_IPM_2_0_CM_single 0 0 -3.4E+38 3.4E+38 ECU_ADDRESS 0x0000e024 /end MEASUREMENT
/begin MEASUREMENT DEKF_Rs "" FLOAT32_IEEE TEST_IPM_2_0_CM_single 0 0 -3.4E+38 3.4E+38 ECU_ADDRESS 0x0000e026 /end MEASUREMENT
/begin MEASUREMENT DEKF_Ldd "" FLOAT32_IEEE TEST_IPM_2_0_CM_single 0 0 -3.4E+38 3.4E+38 ECU_ADDRESS 0x0000e028 /end MEASUREMENT
/begin MEASUREMENT DEKF_Ldq "" FLOAT32_IEEE TEST_IPM_2_0_CM_single 0 0 -3.4E+38 3.4E+38 ECU_ADDRESS 0x0000e02a /end MEASUREMENT
/begin MEASUREMENT DEKF_Lqq "" FLOAT32_IEEE TEST_IPM_2_0_CM_single 0 0 -3.4E+38 3.4E+38 ECU_ADDRESS 0x0000e02c /end MEASUREMENT
/begin MEASUREMENT DEKF_IdhOb "" FLOAT32_IEEE TEST_IPM_2_0_CM_single 0 0 -3.4E+38 3.4E+38 ECU_ADDRESS 0x0000e02e /end MEASUREMENT
/begin MEASUREMENT DEKF_IqhOb "" FLOAT32_IEEE TEST_IPM_2_0_CM_single 0 0 -3.4E+38 3.4E+38 ECU_ADDRESS 0x0000e030 /end MEASUREMENT
/begin MEASUREMENT HFI_Imd "" FLOAT32_IEEE TEST_IPM_2_0_CM_single 0 0 -3.4E+38 3.4E+38 ECU_ADDRESS 0x0000e032 /end MEASUREMENT
/begin MEASUREMENT HFI_Umd "" FLOAT32_IEEE TEST_IPM_2_0_CM_single 0 0 -3.4E+38 3.4E+38 ECU_ADDRESS 0x0000e034 /end MEASUREMENT
/begin MEASUREMENT HFI_Umq "" FLOAT32_IEEE TEST_IPM_2_0_CM_single 0 0 -3.4E+38 3.4E+38 ECU_ADDRESS 0x0000e036 /end MEASUREMENT
/begin MEASUREMENT HFI_FRQ "" FLOAT32_IEEE TEST_IPM_2_0_CM_single 0 0 -3.4E+38 3.4E+38 ECU_ADDRESS 0x0000e038 /end MEASUREMENT
/begin MEASUREMENT HFI_Imq "" FLOAT32_IEEE TEST_IPM_2_0_CM_single 0 0 -3.4E+38 3.4E+38 ECU_ADDRESS 0x0000e03a /end MEASUREMENT
/begin MEASUREMENT DEKF_R "" FLOAT32_IEEE TEST_IPM_2_0_CM_single 0 0 -3.4E+38 3.4E+38 ECU_ADDRESS 0x0000e03c /end MEASUREMENT
/begin MEASUREMENT DEKF_Qx "" FLOAT32_IEEE TEST_IPM_2_0_CM_single 0 0 -3.4E+38 3.4E+38 ECU_ADDRESS 0x0000e03e /end MEASUREMENT
/begin MEASUREMENT DEKF_QpRs "" FLOAT32_IEEE TEST_IPM_2_0_CM_single 0 0 -3.4E+38 3.4E+38 ECU_ADDRESS 0x0000e040 /end MEASUREMENT
/begin MEASUREMENT DEKF_QpLdd "" FLOAT32_IEEE TEST_IPM_2_0_CM_single 0 0 -3.4E+38 3.4E+38 ECU_ADDRESS 0x0000e042 /end MEASUREMENT
/begin MEASUREMENT DEKF_QpLdq "" FLOAT32_IEEE TEST_IPM_2_0_CM_single 0 0 -3.4E+38 3.4E+38 ECU_ADDRESS 0x0000e044 /end MEASUREMENT
/begin MEASUREMENT DEKF_QpLqq "" FLOAT32_IEEE TEST_IPM_2_0_CM_single 0 0 -3.4E+38 3.4E+38 ECU_ADDRESS 0x0000e046 /end MEASUREMENT
/begin MEASUREMENT DEKF_Phiq0 "" FLOAT32_IEEE TEST_IPM_2_0_CM_single 0 0 -3.4E+38 3.4E+38 ECU_ADDRESS 0x0000e048 /end MEASUREMENT
/begin MEASUREMENT Phi_dOb "" FLOAT32_IEEE TEST_IPM_2_0_CM_single 0 0 -3.4E+38 3.4E+38 ECU_ADDRESS 0x0000e04a /end MEASUREMENT
/begin MEASUREMENT Phi_Rs "" FLOAT32_IEEE TEST_IPM_2_0_CM_single 0 0 -3.4E+38 3.4E+38 ECU_ADDRESS 0x0000e04c /end MEASUREMENT
/begin MEASUREMENT Phi_qOb "" FLOAT32_IEEE TEST_IPM_2_0_CM_single 0 0 -3.4E+38 3.4E+38 ECU_ADDRESS 0x0000e04e /end MEASUREMENT
/begin MEASUREMENT DEKF_Gamma "" FLOAT32_IEEE TEST_IPM_2_0_CM_single 0 0 -3.4E+38 3.4E+38 ECU_ADDRESS 0x0000e050 /end MEASUREMENT
/begin MEASUREMENT DEKF_Udelay "" FLOAT32_IEEE TEST_IPM_2_0_CM_single 0 0 -3.4E+38 3.4E+38 ECU_ADDRESS 0x0000e052 /end MEASUREMENT
/begin MEASUREMENT INITV_RS "" FLOAT32_IEEE TEST_IPM_2_0_CM_single 0 0 -3.4E+38 3.4E+38 ECU_ADDRESS 0x0000e054 /end MEASUREMENT
/begin MEASUREMENT INITV_NDD "" FLOAT32_IEEE TEST_IPM_2_0_CM_single 0 0 -3.4E+38 3.4E+38 ECU_ADDRESS 0x0000e056 /end MEASUREMENT
/begin MEASUREMENT INITV_NDQ "" FLOAT32_IEEE TEST_IPM_2_0_CM_single 0 0 -3.4E+38 3.4E+38 ECU_ADDRESS 0x0000e058 /end MEASUREMENT
/begin MEASUREMENT INITV_NQQ "" FLOAT32_IEEE TEST_IPM_2_0_CM_single 0 0 -3.4E+38 3.4E+38 ECU_ADDRESS 0x0000e05a /end MEASUREMENT
/begin MEASUREMENT Id_Filter "" FLOAT32_IEEE TEST_IPM_2_0_CM_single 0 0 -3.4E+38 3.4E+38 ECU_ADDRESS 0x0000e05c /end MEASUREMENT
/begin MEASUREMENT Iq_Filter "" FLOAT32_IEEE TEST_IPM_2_0_CM_single 0 0 -3.4E+38 3.4E+38 ECU_ADDRESS 0x0000e05e /end MEASUREMENT
/begin MEASUREMENT Tr_Phidm "" FLOAT32_IEEE TEST_IPM_2_0_CM_single 0 0 -3.4E+38 3.4E+38 ECU_ADDRESS 0x0000e060 /end MEASUREMENT
/begin MEASUREMENT Tr_Lqap "" FLOAT32_IEEE TEST_IPM_2_0_CM_single 0 0 -3.4E+38 3.4E+38 ECU_ADDRESS 0x0000e062 /end MEASUREMENT
/begin MEASUREMENT Tr_Lqinc "" FLOAT32_IEEE TEST_IPM_2_0_CM_single 0 0 -3.4E+38 3.4E+38 ECU_ADDRESS 0x0000e064 /end MEASUREMENT
/begin MEASUREMENT Tr_Ldap "" FLOAT32_IEEE TEST_IPM_2_0_CM_single 0 0 -3.4E+38 3.4E+38 ECU_ADDRESS 0x0000e066 /end MEASUREMENT
/begin MEASUREMENT Tr_Ldinc "" FLOAT32_IEEE TEST_IPM_2_0_CM_single 0 0 -3.4E+38 3.4E+38 ECU_ADDRESS 0x0000e068 /end MEASUREMENT
/begin MEASUREMENT V_OFFSET "" FLOAT32_IEEE TEST_IPM_2_0_CM_single 0 0 -3.4E+38 3.4E+38 ECU_ADDRESS 0x0000e06a /end MEASUREMENT
/begin MEASUREMENT Tr_Ldqinc "" FLOAT32_IEEE TEST_IPM_2_0_CM_single 0 0 -3.4E+38 3.4E+38 ECU_ADDRESS 0x0000e06c /end MEASUREMENT
/begin MEASUREMENT Tr_Tem "" FLOAT32_IEEE TEST_IPM_2_0_CM_single 0 0 -3.4E+38 3.4E+38 ECU_ADDRESS 0x0000e06e /end MEASUREMENT
/begin MEASUREMENT Tr_Ttotal "" FLOAT32_IEEE TEST_IPM_2_0_CM_single 0 0 -3.4E+38 3.4E+38 ECU_ADDRESS 0x0000e070 /end MEASUREMENT
/begin MEASUREMENT MRAS_Ld "" FLOAT32_IEEE TEST_IPM_2_0_CM_single 0 0 -3.4E+38 3.4E+38 ECU_ADDRESS 0x0000e072 /end MEASUREMENT
/begin MEASUREMENT MRAS_Lq "" FLOAT32_IEEE TEST_IPM_2_0_CM_single 0 0 -3.4E+38 3.4E+38 ECU_ADDRESS 0x0000e074 /end MEASUREMENT
/begin MEASUREMENT MRAS_KR "" FLOAT32_IEEE TEST_IPM_2_0_CM_single 0 0 -3.4E+38 3.4E+38 ECU_ADDRESS 0x0000e076 /end MEASUREMENT
/begin MEASUREMENT MRAS_KLd "" FLOAT32_IEEE TEST_IPM_2_0_CM_single 0 0 -3.4E+38 3.4E+38 ECU_ADDRESS 0x0000e078 /end MEASUREMENT
/begin MEASUREMENT MRAS_KLq "" FLOAT32_IEEE TEST_IPM_2_0_CM_single 0 0 -3.4E+38 3.4E+38 ECU_ADDRESS 0x0000e07a /end MEASUREMENT
/begin MEASUREMENT MRAS_Idh "" FLOAT32_IEEE TEST_IPM_2_0_CM_single 0 0 -3.4E+38 3.4E+38 ECU_ADDRESS 0x0000e07c /end MEASUREMENT
/begin MEASUREMENT MRAS_Iqh "" FLOAT32_IEEE TEST_IPM_2_0_CM_single 0 0 -3.4E+38 3.4E+38 ECU_ADDRESS 0x0000e07e /end MEASUREMENT
/begin MEASUREMENT PI_Multi "" FLOAT32_IEEE TEST_IPM_2_0_CM_single 0 0 -3.4E+38 3.4E+38 ECU_ADDRESS 0x0000e080 /end MEASUREMENT
/begin MEASUREMENT THERMAL_Ud "" FLOAT32_IEEE TEST_IPM_2_0_CM_single 0 0 -3.4E+38 3.4E+38 ECU_ADDRESS 0x0000e082 /end MEASUREMENT
/begin MEASUREMENT THERMAL_Uq "" FLOAT32_IEEE TEST_IPM_2_0_CM_single 0 0 -3.4E+38 3.4E+38 ECU_ADDRESS 0x0000e084 /end MEASUREMENT
/begin MEASUREMENT THERMAL_IdRef "" FLOAT32_IEEE TEST_IPM_2_0_CM_single 0 0 -3.4E+38 3.4E+38 ECU_ADDRESS 0x0000e086 /end MEASUREMENT
/begin MEASUREMENT THERMAL_IqRef "" FLOAT32_IEEE TEST_IPM_2_0_CM_single 0 0 -3.4E+38 3.4E+38 ECU_ADDRESS 0x0000e088 /end MEASUREMENT
/begin MEASUREMENT THERMAL_IdFbk "" FLOAT32_IEEE TEST_IPM_2_0_CM_single 0 0 -3.4E+38 3.4E+38 ECU_ADDRESS 0x0000e08a /end MEASUREMENT
/begin MEASUREMENT THERMAL_IqFbk "" FLOAT32_IEEE TEST_IPM_2_0_CM_single 0 0 -3.4E+38 3.4E+38 ECU_ADDRESS 0x0000e08c /end MEASUREMENT
/begin MEASUREMENT THERMAL_N "" FLOAT32_IEEE TEST_IPM_2_0_CM_single 0 0 -3.4E+38 3.4E+38 ECU_ADDRESS 0x0000e08e /end MEASUREMENT
/begin MEASUREMENT THERMAL_Pele "" FLOAT32_IEEE TEST_IPM_2_0_CM_single 0 0 -3.4E+38 3.4E+38 ECU_ADDRESS 0x0000e090 /end MEASUREMENT
/begin MEASUREMENT Udc_Filter "" FLOAT32_IEEE TEST_IPM_2_0_CM_single 0 0 -3.4E+38 3.4E+38 ECU_ADDRESS 0x0000e092 /end MEASUREMENT
/begin MEASUREMENT W_OFFSET "" FLOAT32_IEEE TEST_IPM_2_0_CM_single 0 0 -3.4E+38 3.4E+38 ECU_ADDRESS 0x0000e094 /end MEASUREMENT
/begin MEASUREMENT Udc_REF "" FLOAT32_IEEE TEST_IPM_2_0_CM_single 0 0 -3.4E+38 3.4E+38 ECU_ADDRESS 0x0000e096 /end MEASUREMENT
/begin MEASUREMENT Udc_FBK "" FLOAT32_IEEE TEST_IPM_2_0_CM_single 0 0 -3.4E+38 3.4E+38 ECU_ADDRESS 0x0000e098 /end MEASUREMENT
/begin MEASUREMENT Udc_Kp "" FLOAT32_IEEE TEST_IPM_2_0_CM_single 0 0 -3.4E+38 3.4E+38 ECU_ADDRESS 0x0000e09a /end MEASUREMENT
/begin MEASUREMENT Udc_Ki "" FLOAT32_IEEE TEST_IPM_2_0_CM_single 0 0 -3.4E+38 3.4E+38 ECU_ADDRESS 0x0000e09c /end MEASUREMENT
/begin MEASUREMENT Udc_Integral "" FLOAT32_IEEE TEST_IPM_2_0_CM_single 0 0 -3.4E+38 3.4E+38 ECU_ADDRESS 0x0000e09e /end MEASUREMENT
/begin MEASUREMENT Udc_Dem "" FLOAT32_IEEE TEST_IPM_2_0_CM_single 0 0 -3.4E+38 3.4E+38 ECU_ADDRESS 0x0000e0a0 /end MEASUREMENT
/begin MEASUREMENT Udc_Step "" FLOAT32_IEEE TEST_IPM_2_0_CM_single 0 0 -3.4E+38 3.4E+38 ECU_ADDRESS 0x0000e0a2 /end MEASUREMENT
/begin MEASUREMENT FbL_Ld "" FLOAT32_IEEE TEST_IPM_2_0_CM_single 0 0 -3.4E+38 3.4E+38 ECU_ADDRESS 0x0000e0a4 /end MEASUREMENT
/begin MEASUREMENT FbL_Lq "" FLOAT32_IEEE TEST_IPM_2_0_CM_single 0 0 -3.4E+38 3.4E+38 ECU_ADDRESS 0x0000e0a6 /end MEASUREMENT
/begin MEASUREMENT FbL_Phif "" FLOAT32_IEEE TEST_IPM_2_0_CM_single 0 0 -3.4E+38 3.4E+38 ECU_ADDRESS 0x0000e0a8 /end MEASUREMENT
/begin MEASUREMENT FbL_Rs "" FLOAT32_IEEE TEST_IPM_2_0_CM_single 0 0 -3.4E+38 3.4E+38 ECU_ADDRESS 0x0000e0aa /end MEASUREMENT
/begin MEASUREMENT FbL_Cdc "" FLOAT32_IEEE TEST_IPM_2_0_CM_single 0 0 -3.4E+38 3.4E+38 ECU_ADDRESS 0x0000e0ac /end MEASUREMENT
/begin MEASUREMENT FbL_z1 "" FLOAT32_IEEE TEST_IPM_2_0_CM_single 0 0 -3.4E+38 3.4E+38 ECU_ADDRESS 0x0000e0ae /end MEASUREMENT
/begin MEASUREMENT FbL_z2 "" FLOAT32_IEEE TEST_IPM_2_0_CM_single 0 0 -3.4E+38 3.4E+38 ECU_ADDRESS 0x0000e0b0 /end MEASUREMENT
/begin MEASUREMENT FbL_z3 "" FLOAT32_IEEE TEST_IPM_2_0_CM_single 0 0 -3.4E+38 3.4E+38 ECU_ADDRESS 0x0000e0b2 /end MEASUREMENT
/begin MEASUREMENT FbL_ud "" FLOAT32_IEEE TEST_IPM_2_0_CM_single 0 0 -3.4E+38 3.4E+38 ECU_ADDRESS 0x0000e0b4 /end MEASUREMENT
/begin MEASUREMENT FbL_uq "" FLOAT32_IEEE TEST_IPM_2_0_CM_single 0 0 -3.4E+38 3.4E+38 ECU_ADDRESS 0x0000e0b6 /end MEASUREMENT
/begin MEASUREMENT FbL_Rdc "" FLOAT32_IEEE TEST_IPM_2_0_CM_single 0 0 -3.4E+38 3.4E+38 ECU_ADDRESS 0x0000e0b8 /end MEASUREMENT
/begin MEASUREMENT Ud_in "" FLOAT32_IEEE TEST_IPM_2_0_CM_single 0 0 -3.4E+38 3.4E+38 ECU_ADDRESS 0x0000e0ba /end MEASUREMENT
/begin MEASUREMENT Uq_in "" FLOAT32_IEEE TEST_IPM_2_0_CM_single 0 0 -3.4E+38 3.4E+38 ECU_ADDRESS 0x0000e0bc /end MEASUREMENT
/begin MEASUREMENT CLA_Data "" FLOAT32_IEEE TEST_IPM_2_0_CM_single 0 0 -3.4E+38 3.4E+38 ECU_ADDRESS 0x00001500 /end MEASUREMENT
/begin MEASUREMENT FbL_k0 "" FLOAT32_IEEE TEST_IPM_2_0_CM_single 0 0 -3.4E+38 3.4E+38 ECU_ADDRESS 0x0000e0be /end MEASUREMENT
/begin MEASUREMENT FbL_k1 "" FLOAT32_IEEE TEST_IPM_2_0_CM_single 0 0 -3.4E+38 3.4E+38 ECU_ADDRESS 0x0000e0c0 /end MEASUREMENT
/begin MEASUREMENT FbL_k2 "" FLOAT32_IEEE TEST_IPM_2_0_CM_single 0 0 -3.4E+38 3.4E+38 ECU_ADDRESS 0x0000e0c2 /end MEASUREMENT
/begin MEASUREMENT FbL_k4 "" FLOAT32_IEEE TEST_IPM_2_0_CM_single 0 0 -3.4E+38 3.4E+38 ECU_ADDRESS 0x0000e0c4 /end MEASUREMENT
/begin MEASUREMENT FbL_k5 "" FLOAT32_IEEE TEST_IPM_2_0_CM_single 0 0 -3.4E+38 3.4E+38 ECU_ADDRESS 0x0000e0c6 /end MEASUREMENT
/begin MEASUREMENT FbL_k3 "" FLOAT32_IEEE TEST_IPM_2_0_CM_single 0 0 -3.4E+38 3.4E+38 ECU_ADDRESS 0x0000e0c8 /end MEASUREMENT
/begin MEASUREMENT FbL_z1ref "" FLOAT32_IEEE TEST_IPM_2_0_CM_single 0 0 -3.4E+38 3.4E+38 ECU_ADDRESS 0x0000e0ca /end MEASUREMENT
/begin MEASUREMENT FbL_v1 "" FLOAT32_IEEE TEST_IPM_2_0_CM_single 0 0 -3.4E+38 3.4E+38 ECU_ADDRESS 0x0000e0cc /end MEASUREMENT
/begin MEASUREMENT FbL_v2 "" FLOAT32_IEEE TEST_IPM_2_0_CM_single 0 0 -3.4E+38 3.4E+38 ECU_ADDRESS 0x0000e0ce /end MEASUREMENT
/begin MEASUREMENT FbL_z1_Integral "" FLOAT32_IEEE TEST_IPM_2_0_CM_single 0 0 -3.4E+38 3.4E+38 ECU_ADDRESS 0x0000e0d0 /end MEASUREMENT
/begin MEASUREMENT FbL_z3_Integral "" FLOAT32_IEEE TEST_IPM_2_0_CM_single 0 0 -3.4E+38 3.4E+38 ECU_ADDRESS 0x0000e0d2 /end MEASUREMENT
/begin MEASUREMENT FbL_Udc_Integral "" FLOAT32_IEEE TEST_IPM_2_0_CM_single 0 0 -3.4E+38 3.4E+38 ECU_ADDRESS 0x0000e0d4 /end MEASUREMENT
/begin MEASUREMENT FbL_iqMuti "" FLOAT32_IEEE TEST_IPM_2_0_CM_single 0 0 -3.4E+38 3.4E+38 ECU_ADDRESS 0x0000e0d6 /end MEASUREMENT
/begin MEASUREMENT FbL_Phif6Amp "" FLOAT32_IEEE TEST_IPM_2_0_CM_single 0 0 -3.4E+38 3.4E+38 ECU_ADDRESS 0x0000e0d8 /end MEASUREMENT
/begin MEASUREMENT FbL_Phif6Pha "" FLOAT32_IEEE TEST_IPM_2_0_CM_single 0 0 -3.4E+38 3.4E+38 ECU_ADDRESS 0x0000e0da /end MEASUREMENT
/begin MEASUREMENT FbL_Phif6wave "" FLOAT32_IEEE TEST_IPM_2_0_CM_single 0 0 -3.4E+38 3.4E+38 ECU_ADDRESS 0x0000e0dc /end MEASUREMENT
/begin MEASUREMENT smc_c "" FLOAT32_IEEE TEST_IPM_2_0_CM_single 0 0 -3.4E+38 3.4E+38 ECU_ADDRESS 0x0000e0de /end MEASUREMENT
/begin MEASUREMENT smc_r "" FLOAT32_IEEE TEST_IPM_2_0_CM_single 0 0 -3.4E+38 3.4E+38 ECU_ADDRESS 0x0000e0e0 /end MEASUREMENT
/begin MEASUREMENT smc_b1 "" FLOAT32_IEEE TEST_IPM_2_0_CM_single 0 0 -3.4E+38 3.4E+38 ECU_ADDRESS 0x0000e0e2 /end MEASUREMENT
/begin MEASUREMENT smc_b2 "" FLOAT32_IEEE TEST_IPM_2_0_CM_single 0 0 -3.4E+38 3.4E+38 ECU_ADDRESS 0x0000e0e4 /end MEASUREMENT
/begin MEASUREMENT V_Current "" FLOAT32_IEEE TEST_IPM_2_0_CM_single 0 0 -3.4E+38 3.4E+38 ECU_ADDRESS 0x0000e0e6 /end MEASUREMENT
/begin MEASUREMENT smc_uqset "" FLOAT32_IEEE TEST_IPM_2_0_CM_single 0 0 -3.4E+38 3.4E+38 ECU_ADDRESS 0x0000e0e8 /end MEASUREMENT
/begin MEASUREMENT smc_x1_integral "" FLOAT32_IEEE TEST_IPM_2_0_CM_single 0 0 -3.4E+38 3.4E+38 ECU_ADDRESS 0x0000e0ea /end MEASUREMENT
/begin MEASUREMENT smc_e1_integral "" FLOAT32_IEEE TEST_IPM_2_0_CM_single 0 0 -3.4E+38 3.4E+38 ECU_ADDRESS 0x0000e0ec /end MEASUREMENT
/begin MEASUREMENT smc_z1_integral "" FLOAT32_IEEE TEST_IPM_2_0_CM_single 0 0 -3.4E+38 3.4E+38 ECU_ADDRESS 0x0000e0ee /end MEASUREMENT
/begin MEASUREMENT smc_en "" FLOAT32_IEEE TEST_IPM_2_0_CM_single 0 0 -3.4E+38 3.4E+38 ECU_ADDRESS 0x0000e0f0 /end MEASUREMENT
/begin MEASUREMENT smc_f "" FLOAT32_IEEE TEST_IPM_2_0_CM_single 0 0 -3.4E+38 3.4E+38 ECU_ADDRESS 0x0000e0f2 /end MEASUREMENT
/begin MEASUREMENT FbL_smc_integral "" FLOAT32_IEEE TEST_IPM_2_0_CM_single 0 0 -3.4E+38 3.4E+38 ECU_ADDRESS 0x0000e0f4 /end MEASUREMENT
/begin MEASUREMENT FbL_smc_r1 "" FLOAT32_IEEE TEST_IPM_2_0_CM_single 0 0 -3.4E+38 3.4E+38 ECU_ADDRESS 0x0000e0f6 /end MEASUREMENT
/begin MEASUREMENT FbL_smc_r2 "" FLOAT32_IEEE TEST_IPM_2_0_CM_single 0 0 -3.4E+38 3.4E+38 ECU_ADDRESS 0x0000e0f8 /end MEASUREMENT
/begin MEASUREMENT W_Current "" FLOAT32_IEEE TEST_IPM_2_0_CM_single 0 0 -3.4E+38 3.4E+38 ECU_ADDRESS 0x0000e0fa /end MEASUREMENT
/begin MEASUREMENT U_Current "" FLOAT32_IEEE TEST_IPM_2_0_CM_single 0 0 -3.4E+38 3.4E+38 ECU_ADDRESS 0x0000e0fc /end MEASUREMENT
/begin MEASUREMENT Id_FBK "" FLOAT32_IEEE TEST_IPM_2_0_CM_single 0 0 -3.4E+38 3.4E+38 ECU_ADDRESS 0x0000e0fe /end MEASUREMENT
/begin MEASUREMENT Iq_FBK "" FLOAT32_IEEE TEST_IPM_2_0_CM_single 0 0 -3.4E+38 3.4E+38 ECU_ADDRESS 0x0000e100 /end MEASUREMENT
/begin MEASUREMENT Id_REF "" FLOAT32_IEEE TEST_IPM_2_0_CM_single 0 0 -3.4E+38 3.4E+38 ECU_ADDRESS 0x0000e102 /end MEASUREMENT
/begin MEASUREMENT Iq_REF "" FLOAT32_IEEE TEST_IPM_2_0_CM_single 0 0 -3.4E+38 3.4E+38 ECU_ADDRESS 0x0000e104 /end MEASUREMENT
/begin MEASUREMENT Id_Kp "" FLOAT32_IEEE TEST_IPM_2_0_CM_single 0 0 -3.4E+38 3.4E+38 ECU_ADDRESS 0x0000e106 /end MEASUREMENT
/begin MEASUREMENT Iq_Kp "" FLOAT32_IEEE TEST_IPM_2_0_CM_single 0 0 -3.4E+38 3.4E+38 ECU_ADDRESS 0x0000e108 /end MEASUREMENT
/begin MEASUREMENT Id_Ki "" FLOAT32_IEEE TEST_IPM_2_0_CM_single 0 0 -3.4E+38 3.4E+38 ECU_ADDRESS 0x0000e10a /end MEASUREMENT
/begin MEASUREMENT Iq_Ki "" FLOAT32_IEEE TEST_IPM_2_0_CM_single 0 0 -3.4E+38 3.4E+38 ECU_ADDRESS 0x0000e10c /end MEASUREMENT
/begin MEASUREMENT ResloverAng "" FLOAT32_IEEE TEST_IPM_2_0_CM_single 0 0 -3.4E+38 3.4E+38 ECU_ADDRESS 0x0000e10e /end MEASUREMENT
/begin MEASUREMENT N_FBK "" FLOAT32_IEEE TEST_IPM_2_0_CM_single 0 0 -3.4E+38 3.4E+38 ECU_ADDRESS 0x0000e110 /end MEASUREMENT
/begin MEASUREMENT N_REF "" FLOAT32_IEEE TEST_IPM_2_0_CM_single 0 0 -3.4E+38 3.4E+38 ECU_ADDRESS 0x0000e112 /end MEASUREMENT
/begin MEASUREMENT N_Filter "" FLOAT32_IEEE TEST_IPM_2_0_CM_single 0 0 -3.4E+38 3.4E+38 ECU_ADDRESS 0x0000e114 /end MEASUREMENT
/begin MEASUREMENT N_Kp "" FLOAT32_IEEE TEST_IPM_2_0_CM_single 0 0 -3.4E+38 3.4E+38 ECU_ADDRESS 0x0000e116 /end MEASUREMENT
/begin MEASUREMENT N_Ki "" FLOAT32_IEEE TEST_IPM_2_0_CM_single 0 0 -3.4E+38 3.4E+38 ECU_ADDRESS 0x0000e118 /end MEASUREMENT
/begin MEASUREMENT ControlAng "" FLOAT32_IEEE TEST_IPM_2_0_CM_single 0 0 -3.4E+38 3.4E+38 ECU_ADDRESS 0x0000e11a /end MEASUREMENT
/begin MEASUREMENT N_Integral "" FLOAT32_IEEE TEST_IPM_2_0_CM_single 0 0 -3.4E+38 3.4E+38 ECU_ADDRESS 0x0000e11c /end MEASUREMENT
/begin MEASUREMENT Id_Integral "" FLOAT32_IEEE TEST_IPM_2_0_CM_single 0 0 -3.4E+38 3.4E+38 ECU_ADDRESS 0x0000e11e /end MEASUREMENT
/begin MEASUREMENT Iq_Integral "" FLOAT32_IEEE TEST_IPM_2_0_CM_single 0 0 -3.4E+38 3.4E+38 ECU_ADDRESS 0x0000e120 /end MEASUREMENT
/begin MEASUREMENT TempA "" FLOAT32_IEEE TEST_IPM_2_0_CM_single 0 0 -3.4E+38 3.4E+38 ECU_ADDRESS 0x0000e122 /end MEASUREMENT
/begin MEASUREMENT TempB "" FLOAT32_IEEE TEST_IPM_2_0_CM_single 0 0 -3.4E+38 3.4E+38 ECU_ADDRESS 0x0000e124 /end MEASUREMENT
/begin MEASUREMENT TempC "" FLOAT32_IEEE TEST_IPM_2_0_CM_single 0 0 -3.4E+38 3.4E+38 ECU_ADDRESS 0x0000e126 /end MEASUREMENT
/begin MEASUREMENT UDC "" FLOAT32_IEEE TEST_IPM_2_0_CM_single 0 0 -3.4E+38 3.4E+38 ECU_ADDRESS 0x0000e128 /end MEASUREMENT
/begin MEASUREMENT UDCPROTECT "" FLOAT32_IEEE TEST_IPM_2_0_CM_single 0 0 -3.4E+38 3.4E+38 ECU_ADDRESS 0x0000e12a /end MEASUREMENT
/begin MEASUREMENT VF_Ud "" FLOAT32_IEEE TEST_IPM_2_0_CM_single 0 0 -3.4E+38 3.4E+38 ECU_ADDRESS 0x0000e12c /end MEASUREMENT
/begin MEASUREMENT VF_Uq "" FLOAT32_IEEE TEST_IPM_2_0_CM_single 0 0 -3.4E+38 3.4E+38 ECU_ADDRESS 0x0000e12e /end MEASUREMENT
/begin MEASUREMENT VF_F "" FLOAT32_IEEE TEST_IPM_2_0_CM_single 0 0 -3.4E+38 3.4E+38 ECU_ADDRESS 0x0000e130 /end MEASUREMENT
/begin MEASUREMENT VF_F_Step "" FLOAT32_IEEE TEST_IPM_2_0_CM_single 0 0 -3.4E+38 3.4E+38 ECU_ADDRESS 0x0000e132 /end MEASUREMENT
/begin MEASUREMENT IF_F "" FLOAT32_IEEE TEST_IPM_2_0_CM_single 0 0 -3.4E+38 3.4E+38 ECU_ADDRESS 0x0000e134 /end MEASUREMENT
/begin MEASUREMENT IF_F_Step "" FLOAT32_IEEE TEST_IPM_2_0_CM_single 0 0 -3.4E+38 3.4E+38 ECU_ADDRESS 0x0000e136 /end MEASUREMENT
/begin MEASUREMENT UDOUT "" FLOAT32_IEEE TEST_IPM_2_0_CM_single 0 0 -3.4E+38 3.4E+38 ECU_ADDRESS 0x0000e138 /end MEASUREMENT
/begin MEASUREMENT UQOUT "" FLOAT32_IEEE TEST_IPM_2_0_CM_single 0 0 -3.4E+38 3.4E+38 ECU_ADDRESS 0x0000e13a /end MEASUREMENT
/begin MEASUREMENT USOUT "" FLOAT32_IEEE TEST_IPM_2_0_CM_single 0 0 -3.4E+38 3.4E+38 ECU_ADDRESS 0x0000e13c /end MEASUREMENT
/begin MEASUREMENT U_OFFSET "" FLOAT32_IEEE TEST_IPM_2_0_CM_single 0 0 -3.4E+38 3.4E+38 ECU_ADDRESS 0x0000e13e /end MEASUREMENT
/begin MEASUREMENT N_Dem "" FLOAT32_IEEE TEST_IPM_2_0_CM_single 0 0 -3.4E+38 3.4E+38 ECU_ADDRESS 0x0000e140 /end MEASUREMENT
/begin MEASUREMENT N_Step "" FLOAT32_IEEE TEST_IPM_2_0_CM_single 0 0 -3.4E+38 3.4E+38 ECU_ADDRESS 0x0000e142 /end MEASUREMENT
/begin MEASUREMENT ArrayId_FBK "" FLOAT32_IEEE TEST_IPM_2_0_CM_single 0 0 -3.4E+38 3.4E+38 ECU_ADDRESS 0x0000e144 /end MEASUREMENT
/begin MEASUREMENT ArrayIq_FBK "" FLOAT32_IEEE TEST_IPM_2_0_CM_single 0 0 -3.4E+38 3.4E+38 ECU_ADDRESS 0x0000e146 /end MEASUREMENT
/begin MEASUREMENT ArrayTheta "" FLOAT32_IEEE TEST_IPM_2_0_CM_single 0 0 -3.4E+38 3.4E+38 ECU_ADDRESS 0x0000e148 /end MEASUREMENT
/begin MEASUREMENT BufferOutId_FBK "" FLOAT32_IEEE TEST_IPM_2_0_CM_single 0 0 -3.4E+38 3.4E+38 ECU_ADDRESS 0x0000e14a /end MEASUREMENT
/begin MEASUREMENT BufferOutIq_FBK "" FLOAT32_IEEE TEST_IPM_2_0_CM_single 0 0 -3.4E+38 3.4E+38 ECU_ADDRESS 0x0000e14c /end MEASUREMENT
/begin MEASUREMENT BufferOutTheta "" FLOAT32_IEEE TEST_IPM_2_0_CM_single 0 0 -3.4E+38 3.4E+38 ECU_ADDRESS 0x0000e14e /end MEASUREMENT
/begin MEASUREMENT UDOUT_Comp "" FLOAT32_IEEE TEST_IPM_2_0_CM_single 0 0 -3.4E+38 3.4E+38 ECU_ADDRESS 0x0000e150 /end MEASUREMENT
/begin MEASUREMENT UQOUT_Comp "" FLOAT32_IEEE TEST_IPM_2_0_CM_single 0 0 -3.4E+38 3.4E+38 ECU_ADDRESS 0x0000e152 /end MEASUREMENT
/begin MEASUREMENT USOUT_Comp "" FLOAT32_IEEE TEST_IPM_2_0_CM_single 0 0 -3.4E+38 3.4E+38 ECU_ADDRESS 0x0000e154 /end MEASUREMENT
/begin MEASUREMENT K "" FLOAT32_IEEE TEST_IPM_2_0_CM_single 0 0 -3.4E+38 3.4E+38 ECU_ADDRESS 0x0000e156 /end MEASUREMENT
/begin MEASUREMENT Udelta "" FLOAT32_IEEE TEST_IPM_2_0_CM_single 0 0 -3.4E+38 3.4E+38 ECU_ADDRESS 0x0000e158 /end MEASUREMENT
/begin MEASUREMENT ArrayId_REF "" FLOAT32_IEEE TEST_IPM_2_0_CM_single 0 0 -3.4E+38 3.4E+38 ECU_ADDRESS 0x0000e15a /end MEASUREMENT
/begin MEASUREMENT ArrayIq_REF "" FLOAT32_IEEE TEST_IPM_2_0_CM_single 0 0 -3.4E+38 3.4E+38 ECU_ADDRESS 0x0000e15c /end MEASUREMENT
/begin MEASUREMENT BufferOutId_REF "" FLOAT32_IEEE TEST_IPM_2_0_CM_single 0 0 -3.4E+38 3.4E+38 ECU_ADDRESS 0x0000e15e /end MEASUREMENT
/begin MEASUREMENT BufferOutIq_REF "" FLOAT32_IEEE TEST_IPM_2_0_CM_single 0 0 -3.4E+38 3.4E+38 ECU_ADDRESS 0x0000e160 /end MEASUREMENT
/begin MEASUREMENT ArrayUdComP "" FLOAT32_IEEE TEST_IPM_2_0_CM_single 0 0 -3.4E+38 3.4E+38 ECU_ADDRESS 0x0000e162 /end MEASUREMENT
/begin MEASUREMENT ArrayUqComP "" FLOAT32_IEEE TEST_IPM_2_0_CM_single 0 0 -3.4E+38 3.4E+38 ECU_ADDRESS 0x0000e164 /end MEASUREMENT
/begin MEASUREMENT BufferOutUdComP "" FLOAT32_IEEE TEST_IPM_2_0_CM_single 0 0 -3.4E+38 3.4E+38 ECU_ADDRESS 0x0000e166 /end MEASUREMENT
/begin MEASUREMENT BufferOutUqComP "" FLOAT32_IEEE TEST_IPM_2_0_CM_single 0 0 -3.4E+38 3.4E+38 ECU_ADDRESS 0x0000e168 /end MEASUREMENT
/begin MEASUREMENT UdComP_Filter "" FLOAT32_IEEE TEST_IPM_2_0_CM_single 0 0 -3.4E+38 3.4E+38 ECU_ADDRESS 0x0000e16a /end MEASUREMENT
/begin MEASUREMENT UqComP_Filter "" FLOAT32_IEEE TEST_IPM_2_0_CM_single 0 0 -3.4E+38 3.4E+38 ECU_ADDRESS 0x0000e16c /end MEASUREMENT
/begin MEASUREMENT UsComP_Filter "" FLOAT32_IEEE TEST_IPM_2_0_CM_single 0 0 -3.4E+38 3.4E+38 ECU_ADDRESS 0x0000e16e /end MEASUREMENT
/begin MEASUREMENT N_400Hz "" FLOAT32_IEEE TEST_IPM_2_0_CM_single 0 0 -3.4E+38 3.4E+38 ECU_ADDRESS 0x0000e170 /end MEASUREMENT
/begin MEASUREMENT DEKF_Idh "" FLOAT32_IEEE TEST_IPM_2_0_CM_single 0 0 -3.4E+38 3.4E+38 ECU_ADDRESS 0x0000e172 /end MEASUREMENT
/begin MEASUREMENT DEKF_Id0 "" FLOAT32_IEEE TEST_IPM_2_0_CM_single 0 0 -3.4E+38 3.4E+38 ECU_ADDRESS 0x0000e174 /end MEASUREMENT
/begin MEASUREMENT DEKF_Iqh "" FLOAT32_IEEE TEST_IPM_2_0_CM_single 0 0 -3.4E+38 3.4E+38 ECU_ADDRESS 0x0000e176 /end MEASUREMENT
/begin MEASUREMENT DEKF_Iq0 "" FLOAT32_IEEE TEST_IPM_2_0_CM_single 0 0 -3.4E+38 3.4E+38 ECU_ADDRESS 0x0000e178 /end MEASUREMENT
/begin MEASUREMENT DEKF_Udh "" FLOAT32_IEEE TEST_IPM_2_0_CM_single 0 0 -3.4E+38 3.4E+38 ECU_ADDRESS 0x0000e17a /end MEASUREMENT
/begin MEASUREMENT DEKF_Ud0 "" FLOAT32_IEEE TEST_IPM_2_0_CM_single 0 0 -3.4E+38 3.4E+38 ECU_ADDRESS 0x0000e17c /end MEASUREMENT
/begin MEASUREMENT DEKF_Uqh "" FLOAT32_IEEE TEST_IPM_2_0_CM_single 0 0 -3.4E+38 3.4E+38 ECU_ADDRESS 0x0000e17e /end MEASUREMENT
/begin MEASUREMENT DEKF_Uq0 "" FLOAT32_IEEE TEST_IPM_2_0_CM_single 0 0 -3.4E+38 3.4E+38 ECU_ADDRESS 0x0000e180 /end MEASUREMENT
/begin MEASUREMENT DEKF_Phid0 "" FLOAT32_IEEE TEST_IPM_2_0_CM_single 0 0 -3.4E+38 3.4E+38 ECU_ADDRESS 0x0000e182 /end MEASUREMENT
/begin MEASUREMENT N_NOFILTER "" FLOAT32_IEEE TEST_IPM_2_0_CM_single 0 0 -3.4E+38 3.4E+38 ECU_ADDRESS 0x0000e184 /end MEASUREMENT
/begin MEASUREMENT STOP "" UWORD TEST_IPM_2_0_CM_uint16 0 0 0 65535 ECU_ADDRESS 0x0000e000 /end MEASUREMENT
/begin MEASUREMENT ResloverA0 "" UWORD TEST_IPM_2_0_CM_uint16 0 0 0 65535 ECU_ADDRESS 0x0000e001 /end MEASUREMENT
/begin MEASUREMENT DEKF_FLAG "" UWORD TEST_IPM_2_0_CM_uint16 0 0 0 65535 ECU_ADDRESS 0x0000e002 /end MEASUREMENT
/begin MEASUREMENT ResloverA1 "" UWORD TEST_IPM_2_0_CM_uint16 0 0 0 65535 ECU_ADDRESS 0x0000e003 /end MEASUREMENT
/begin MEASUREMENT ResloverSAMPLE "" UWORD TEST_IPM_2_0_CM_uint16 0 0 0 65535 ECU_ADDRESS 0x0000e004 /end MEASUREMENT
/begin MEASUREMENT DEKF_Clear "" UWORD TEST_IPM_2_0_CM_uint16 0 0 0 65535 ECU_ADDRESS 0x0000e005 /end MEASUREMENT
/begin MEASUREMENT IGBT_Fault "" UWORD TEST_IPM_2_0_CM_uint16 0 0 0 65535 ECU_ADDRESS 0x0000e006 /end MEASUREMENT
/begin MEASUREMENT REVERSE_FLAG "" UWORD TEST_IPM_2_0_CM_uint16 0 0 0 65535 ECU_ADDRESS 0x0000e007 /end MEASUREMENT
/begin MEASUREMENT ResloverRESET "" UWORD TEST_IPM_2_0_CM_uint16 0 0 0 65535 ECU_ADDRESS 0x0000e008 /end MEASUREMENT
/begin MEASUREMENT ResloverFRQ "" UWORD TEST_IPM_2_0_CM_uint16 0 0 0 65535 ECU_ADDRESS 0x0000e009 /end MEASUREMENT
/begin MEASUREMENT InitMode "" UWORD TEST_IPM_2_0_CM_uint16 0 0 0 65535 ECU_ADDRESS 0x0000e00a /end MEASUREMENT
/begin MEASUREMENT ResloverRES "" UWORD TEST_IPM_2_0_CM_uint16 0 0 0 65535 ECU_ADDRESS 0x0000e00b /end MEASUREMENT
/begin MEASUREMENT ChartFlag "" UWORD TEST_IPM_2_0_CM_uint16 0 0 0 65535 ECU_ADDRESS 0x0000e00c /end MEASUREMENT
/begin MEASUREMENT U_AD "" UWORD TEST_IPM_2_0_CM_uint16 0 0 0 65535 ECU_ADDRESS 0x0000e00d /end MEASUREMENT
/begin MEASUREMENT ResloverMid "" UWORD TEST_IPM_2_0_CM_uint16 0 0 0 65535 ECU_ADDRESS 0x0000e00e /end MEASUREMENT
/begin MEASUREMENT ResloverFaultRead "" UWORD TEST_IPM_2_0_CM_uint16 0 0 0 65535 ECU_ADDRESS 0x0000e00f /end MEASUREMENT
/begin MEASUREMENT PROTECT "" UWORD TEST_IPM_2_0_CM_uint16 0 0 0 65535 ECU_ADDRESS 0x0000e010 /end MEASUREMENT
/begin MEASUREMENT V_AD "" UWORD TEST_IPM_2_0_CM_uint16 0 0 0 65535 ECU_ADDRESS 0x0000e011 /end MEASUREMENT
/begin MEASUREMENT ControlMode "" UWORD TEST_IPM_2_0_CM_uint16 0 0 0 65535 ECU_ADDRESS 0x0000e012 /end MEASUREMENT
/begin MEASUREMENT FLAG_MTPA "" UWORD TEST_IPM_2_0_CM_uint16 0 0 0 65535 ECU_ADDRESS 0x0000e013 /end MEASUREMENT
/begin MEASUREMENT W_AD "" UWORD TEST_IPM_2_0_CM_uint16 0 0 0 65535 ECU_ADDRESS 0x0000e014 /end MEASUREMENT
/begin MEASUREMENT COMPARE_A "" UWORD TEST_IPM_2_0_CM_uint16 0 0 0 65535 ECU_ADDRESS 0x0000e015 /end MEASUREMENT
/begin MEASUREMENT COMPARE_B "" UWORD TEST_IPM_2_0_CM_uint16 0 0 0 65535 ECU_ADDRESS 0x0000e016 /end MEASUREMENT
/begin MEASUREMENT COMPARE_C "" UWORD TEST_IPM_2_0_CM_uint16 0 0 0 65535 ECU_ADDRESS 0x0000e017 /end MEASUREMENT
/begin MEASUREMENT SPIC_Tx "" UWORD TEST_IPM_2_0_CM_uint16 0 0 0 65535 ECU_ADDRESS 0x0000e018 /end MEASUREMENT
/begin MEASUREMENT SPIC_Rx "" UWORD TEST_IPM_2_0_CM_uint16 0 0 0 65535 ECU_ADDRESS 0x0000e019 /end MEASUREMENT
/begin MEASUREMENT BufferFlag "" UWORD TEST_IPM_2_0_CM_uint16 0 0 0 65535 ECU_ADDRESS 0x0000e01a /end MEASUREMENT
/begin MEASUREMENT FLAG_5742 "" UWORD TEST_IPM_2_0_CM_uint16 0 0 0 65535 ECU_ADDRESS 0x0000e01b /end MEASUREMENT
/begin MEASUREMENT ResloverWR "" UWORD TEST_IPM_2_0_CM_uint16 0 0 0 65535 ECU_ADDRESS 0x0000e01c /end MEASUREMENT
/begin COMPU_METHOD /* Name of CompuMethod */ TEST_IPM_2_0_CM_single "Q = V" /* Conversion Type */ RAT_FUNC /* Format */ "%8.6" /* Units */ "" /* Coefficients */ COEFFS 0 1 0 0 0 1 /end COMPU_METHOD
/begin COMPU_METHOD /* Name of CompuMethod */ TEST_IPM_2_0_CM_uint16 "Q = V" /* Conversion Type */ RAT_FUNC /* Format */ "%5.0" /* Units */ "" /* Coefficients */ COEFFS 0 1 0 0 0 1 /end COMPU_METHOD
/begin GROUP TEST_IPM_2_0 "TEST_IPM_2_0" /* Root */ ROOT
 /begin REF_MEASUREMENT ArrayId_FBK ArrayId_REF ArrayIq_FBK ArrayIq_REF ArrayTheta ArrayUdComP ArrayUqComP BufferFlag BufferOutId_FBK BufferOutId_REF BufferOutIq_FBK BufferOutIq_REF BufferOutTheta BufferOutUdComP BufferOutUqComP CLA_Data COMPARE_A COMPARE_B COMPARE_C ChartFlag ControlAng ControlMode DEKF_Clear DEKF_FLAG DEKF_Gamma DEKF_Id0 DEKF_Idh DEKF_IdhOb DEKF_Iq0 DEKF_Iqh DEKF_IqhOb DEKF_Ldd DEKF_Ldq DEKF_Lqq DEKF_Phid0 DEKF_Phiq0 DEKF_QpLdd DEKF_QpLdq DEKF_QpLqq DEKF_QpRs DEKF_Qx DEKF_R DEKF_Rs DEKF_Ud0 DEKF_Udelay DEKF_Udh DEKF_Uq0 DEKF_Uqh FLAG_5742 FLAG_MTPA FbL_Cdc FbL_Ld FbL_Lq FbL_Phif FbL_Phif6Amp FbL_Phif6Pha FbL_Phif6wave FbL_Rdc FbL_Rs FbL_Udc_Integral FbL_iqMuti FbL_k0 FbL_k1 FbL_k2 FbL_k3 FbL_k4 FbL_k5 FbL_smc_integral FbL_smc_r1 FbL_smc_r2 FbL_ud FbL_uq FbL_v1 FbL_v2 FbL_z1 FbL_z1_Integral FbL_z1ref FbL_z2 FbL_z3 FbL_z3_Integral HFI_FRQ HFI_Imd HFI_Imq HFI_Umd HFI_Umq IF_F IF_F_Step IGBT_Fault INITV_NDD INITV_NDQ INITV_NQQ INITV_RS Id_FBK Id_Filter Id_Integral Id_Ki Id_Kp Id_REF InitMode Iq_FBK Iq_Filter Iq_Integral Iq_Ki Iq_Kp Iq_REF K MRAS_Idh MRAS_Iqh MRAS_KLd MRAS_KLq MRAS_KR MRAS_Ld MRAS_Lq MRAS_Rs N_400Hz N_Dem N_FBK N_Filter N_Integral N_Ki N_Kp N_NOFILTER N_REF N_Step PI_Multi PROTECT Phi_Rs Phi_dOb Phi_qOb REVERSE_FLAG ResloverA0 ResloverA1 ResloverAng ResloverFRQ ResloverFaultRead ResloverMid ResloverRES ResloverRESET ResloverSAMPLE ResloverWR SPIC_Rx SPIC_Tx STOP THERMAL_IdFbk THERMAL_IdRef THERMAL_IqFbk THERMAL_IqRef THERMAL_N THERMAL_Pele THERMAL_Ud THERMAL_Uq Tem_Dem Tem_Step TempA TempB TempC Tr_Ldap Tr_Ldinc Tr_Ldqinc Tr_Lqap Tr_Lqinc Tr_Phidm Tr_Tem Tr_Ttotal UDC UDCPROTECT UDOUT UDOUT_Comp UQOUT UQOUT_Comp USOUT USOUT_Comp U_AD U_Current U_OFFSET UdComP_Filter Ud_in Udc_Dem Udc_FBK Udc_Filter Udc_Integral Udc_Ki Udc_Kp Udc_REF Udc_Step Udelta UqComP_Filter Uq_in UsComP_Filter VF_F VF_F_Step VF_Ud VF_Uq V_AD V_Current V_OFFSET W_AD W_Current W_OFFSET smc_b1 smc_b2 smc_c smc_e1_integral smc_en smc_f smc_r smc_uqset smc_x1_integral smc_z1_integral /end REF_MEASUREMENT
/end GROUP
/end MODULE
/end PROJECT
/* (add any file trailer comments here) */
/* EOF TEST_IPM_2_0.a2l */
